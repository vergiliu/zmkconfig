## config/boards/shields/hillside46/Kconfig.defconfig
```kconfig
# Copyright (c) 2021-2022 The ZMK Contributors
# SPDX-License-Identifier: MIT

# ------------ LEFT SIDE

if SHIELD_HILLSIDE46_LEFT

config ZMK_KEYBOARD_NAME
    default "keeb02"

config ZMK_SPLIT_BLE_ROLE_CENTRAL
    default y

config I2C
    default y

config SPI
    default y

config ZMK_BLE
    default y

config ZMK_RGB_UNDERGLOW
    select WS2812_STRIP
    select SPI

# config ZMK_DISPLAY
#     select LV_FONT_MONTSERRAT_16
#     select SSD1306
#     # LVGL_FONT_MONTSERRAT_26
#     # LVGL_FONT_MONTSERRAT_12
#     # ZMK_WIDGET_BATTERY_STATUS ...
#
# if ZMK_DISPLAY
#
# config ZMK_WIDGET_BATTERY_STATUS
#     default y
# config ZMK_WIDGET_LAYER_STATUS
#     default y
#
# config ZMK_WIDGET_BATTERY_STATUS_SHOW_PERCENTAGE
#     default y
# # config ZMK_DISPLAY_STATUS_SCREEN_BUILT_IN
# #     default y
# # CONFIG_ZMK_DISPLAY_WORK_QUEUE_SYSTEM=y
# config ZMK_DISPLAY_BLANK_ON_IDLE
#   default n
#
# config LV_Z_BITS_PER_PIXEL
#     default 1
#
# choice LV_COLOR_DEPTH
#     default LV_COLOR_DEPTH_1
# endchoice
#
# if LVGL
#
# config LV_Z_VDB_SIZE
#     default 64
#
# config LV_DPI_DEF
#     default 148
#
# config LV_Z_BITS_PER_PIXEL
#     default 1
#
# endif # LVGL
# endif # ZMK_DISPLAY
endif # SHIELD_HILLSIDE_VIEW_LEFT

# ------------ RIGHT SIDE

if  SHIELD_HILLSIDE_VIEW_RIGHT

config ZMK_KEYBOARD_NAME
    default "keeb02r"

config ZMK_SPLIT_BLE_ROLE_CENTRAL
    default n

config I2C
    default y

config SPI
    default y

config ZMK_BLE
    default y

config ZMK_RGB_UNDERGLOW
    select WS2812_STRIP
    select SPI

config ZMK_SPLIT_BLE_ROLE_CENTRAL
    default n

config ZMK_SPLIT
    default y

endif
```
